/*
    + * Copyright 2012 Freescale Semiconductor, Inc.
    + * Copyright 2011 Linaro Ltd.
    + *
    + * SPDX-License-Identifier:     GPL-2.0+
    + */

/dts-v1/;

/ {
	model = "Freescale i.MX6 DualCore IvenixM5 Board";
	compatible = "fsl,imx6q-ivenixm5", "fsl,imx6q";
};
